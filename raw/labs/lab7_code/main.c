/* USER CODE BEGIN Header */
/**
 ******************************************************************************
  * @file    main.c
  * @author  Dr. Chao Wang, Arizona State University, chao.wang.6@asu.edu
  * @version V1.0.0
  * @date    07/31/2024
 ******************************************************************************
  * @attention
  *
  * Lab 7: Fast Fourier Transform
  *
  * All course materials for this class are protected by copyright and
  * may not be shared, reproduced, or uploaded to any website
  * without the written permission of the instructor.
  ******************************************************************************
 */
/* USER CODE END Header */
/* Includes ------------------------------------------------------------------*/
#include "main.h"

/* Private includes ----------------------------------------------------------*/
/* USER CODE BEGIN Includes */

/* USER CODE END Includes */

/* Private typedef -----------------------------------------------------------*/
/* USER CODE BEGIN PTD */

/* USER CODE END PTD */

/* Private define ------------------------------------------------------------*/
/* USER CODE BEGIN PD */

/* USER CODE END PD */

/* Private macro -------------------------------------------------------------*/
/* USER CODE BEGIN PM */

/* USER CODE END PM */

/* Private variables ---------------------------------------------------------*/

/* USER CODE BEGIN PV */

/* USER CODE END PV */

/* Private function prototypes -----------------------------------------------*/
void SystemClock_Config(void);
static void MX_GPIO_Init(void);
/* USER CODE BEGIN PFP */

/* USER CODE END PFP */

/* Private user code ---------------------------------------------------------*/
/* USER CODE BEGIN 0 */
#include "math.h"
#include "sine_table.h"
struct cmpx
{
    float re;
    float im;
};
typedef struct cmpx complex;

struct icmpx
{
    int32_t re;
    int32_t im;
};
typedef struct icmpx complex_fixed_point;

#define pi 3.1415926535897
#define SCALE 0 /* scale = 1 (to scale), scale = 0 (not to scale) */
#define SIZE_FFT 4           /* Number of FFT points */
#define LOG2_SIZE 2           /* Number of stages: log2(N) */
float test_vector_re[SIZE_FFT]={0.6, 0.3, -0.1, 0.3};
float test_vector_im[SIZE_FFT]={0, 0, 0, 0};
//float test_vector_re[SIZE_FFT]={1, 2, 3, 4, 5, 6, 7, 8};
//float test_vector_im[SIZE_FFT]={0, 0, 0, 0, 0, 0, 0, 0};


complex X[SIZE_FFT];           /* Declare input array  */
complex W[LOG2_SIZE];         /* Twiddle e^(-j2pi/N) table */

uint8_t shift_factor = 15;
complex X_fixed_point_to_float[SIZE_FFT];
complex_fixed_point X_fixed_point[SIZE_FFT];
complex_fixed_point W_fixed_point[LOG2_SIZE];         /* Twiddle e^(-j2pi/N) table */


float spectrum[SIZE_FFT], spectrum_fixed_point[SIZE_FFT];

void bit_rev(complex *X, uint16_t size);
void bit_rev_fixed_point(complex_fixed_point *X, uint16_t size);
void fft(complex *X, uint16_t num_stages, complex *W, uint8_t scale_or_not);
void fft_fixed_point(complex_fixed_point *X, uint16_t num_stages, complex_fixed_point *W, uint8_t scale_or_not);
/* USER CODE END 0 */

/**
  * @brief  The application entry point.
  * @retval int
  */
int main(void)
{

  /* USER CODE BEGIN 1 */

  /* USER CODE END 1 */

  /* MCU Configuration--------------------------------------------------------*/

  /* Reset of all peripherals, Initializes the Flash interface and the Systick. */
  HAL_Init();

  /* USER CODE BEGIN Init */

  /* USER CODE END Init */

  /* Configure the system clock */
  SystemClock_Config();

  /* USER CODE BEGIN SysInit */

  /* USER CODE END SysInit */

  /* Initialize all configured peripherals */
  MX_GPIO_Init();
  /* USER CODE BEGIN 2 */
  unsigned int i,L,num_pt_sub_DFT,num_butterflies;

  /* pre-compute twiddle factor table */
  for (L=1; L<=LOG2_SIZE; L++)
  {
	  num_pt_sub_DFT=1<<L;         /* 2^L=points of sub DFT */
	  num_butterflies=num_pt_sub_DFT>>1;       /* Number of butterflies in sub DFT */

	  W[L-1].re = cos(pi/num_butterflies);
      W[L-1].im = -sin(pi/num_butterflies);

      W_fixed_point[L-1].re = (int32_t)(cos(pi/num_butterflies)*pow(2, shift_factor)); // can't use bitwise operations on floating point numbers
      W_fixed_point[L-1].im = -(int32_t)(sin(pi/num_butterflies)*pow(2, shift_factor));
  }

  /* prepare for FFT: copy numbers to X */
  for (i=0; i<SIZE_FFT; i++)
  {
      /* Generate input samples */

	  X[i].re = test_vector_re[i];
      X[i].im = test_vector_im[i];
      X_fixed_point[i].re = (int32_t)(test_vector_re[i]*pow(2, shift_factor));
      X_fixed_point[i].im = (int32_t)(test_vector_im[i]*pow(2, shift_factor));

/*
	  // sine table generated by MATLAB in sine_table.h
	  X[i].re = sin_f[i];
      X[i].im = 0;
      X_fixed_point[i].re = (int32_t)(sin_f[i]*pow(2, shift_factor));
      X_fixed_point[i].im = 0;
*/
  }

  /* start FFT */
  bit_rev(X,SIZE_FFT);      /* arrange X[] in bit reversal order */
  fft(X,LOG2_SIZE,W,SCALE);      /* perform FFT */


  bit_rev_fixed_point(X_fixed_point,SIZE_FFT);      /* arrange X[] in bit reversal order */
  fft_fixed_point(X_fixed_point,LOG2_SIZE,W_fixed_point,SCALE);      /* perform FFT */


  for (i=0; i<SIZE_FFT; i++)
  {
	  /* convert fixed point to float for verification*/
	  X_fixed_point_to_float[i].re = X_fixed_point[i].re / pow(2, shift_factor); // can't shift, need decimal digits for float
	  X_fixed_point_to_float[i].im = X_fixed_point[i].im / pow(2, shift_factor);

	  /* recover if scaled */
	  if (SCALE) {
		  X[i].re = X[i].re*SIZE_FFT;
		  X[i].im = X[i].im*SIZE_FFT;
		  X_fixed_point_to_float[i].re = X_fixed_point_to_float[i].re*SIZE_FFT;
		  X_fixed_point_to_float[i].im = X_fixed_point_to_float[i].im*SIZE_FFT;
	  }

	  /* computer power spectrum */
	  spectrum[i] = X[i].re * X[i].re + X[i].im * X[i].im;
	  spectrum_fixed_point[i] = X_fixed_point_to_float[i].re * X_fixed_point_to_float[i].re + X_fixed_point_to_float[i].im * X_fixed_point_to_float[i].im;
  }

  /* USER CODE END 2 */

  /* Infinite loop */
  /* USER CODE BEGIN WHILE */
  while (1)
  {
    /* USER CODE END WHILE */

    /* USER CODE BEGIN 3 */
  }
  /* USER CODE END 3 */
}

/**
  * @brief System Clock Configuration
  * @retval None
  */
void SystemClock_Config(void)
{
  RCC_OscInitTypeDef RCC_OscInitStruct = {0};
  RCC_ClkInitTypeDef RCC_ClkInitStruct = {0};

  /** Configure the main internal regulator output voltage
  */
  __HAL_RCC_PWR_CLK_ENABLE();
  __HAL_PWR_VOLTAGESCALING_CONFIG(PWR_REGULATOR_VOLTAGE_SCALE1);

  /** Initializes the RCC Oscillators according to the specified parameters
  * in the RCC_OscInitTypeDef structure.
  */
  RCC_OscInitStruct.OscillatorType = RCC_OSCILLATORTYPE_HSI;
  RCC_OscInitStruct.HSIState = RCC_HSI_ON;
  RCC_OscInitStruct.HSICalibrationValue = RCC_HSICALIBRATION_DEFAULT;
  RCC_OscInitStruct.PLL.PLLState = RCC_PLL_ON;
  RCC_OscInitStruct.PLL.PLLSource = RCC_PLLSOURCE_HSI;
  RCC_OscInitStruct.PLL.PLLM = 8;
  RCC_OscInitStruct.PLL.PLLN = 168;
  RCC_OscInitStruct.PLL.PLLP = RCC_PLLP_DIV2;
  RCC_OscInitStruct.PLL.PLLQ = 7;
  if (HAL_RCC_OscConfig(&RCC_OscInitStruct) != HAL_OK)
  {
    Error_Handler();
  }

  /** Initializes the CPU, AHB and APB buses clocks
  */
  RCC_ClkInitStruct.ClockType = RCC_CLOCKTYPE_HCLK|RCC_CLOCKTYPE_SYSCLK
                              |RCC_CLOCKTYPE_PCLK1|RCC_CLOCKTYPE_PCLK2;
  RCC_ClkInitStruct.SYSCLKSource = RCC_SYSCLKSOURCE_PLLCLK;
  RCC_ClkInitStruct.AHBCLKDivider = RCC_SYSCLK_DIV1;
  RCC_ClkInitStruct.APB1CLKDivider = RCC_HCLK_DIV4;
  RCC_ClkInitStruct.APB2CLKDivider = RCC_HCLK_DIV2;

  if (HAL_RCC_ClockConfig(&RCC_ClkInitStruct, FLASH_LATENCY_5) != HAL_OK)
  {
    Error_Handler();
  }
}

/**
  * @brief GPIO Initialization Function
  * @param None
  * @retval None
  */
static void MX_GPIO_Init(void)
{
  GPIO_InitTypeDef GPIO_InitStruct = {0};
/* USER CODE BEGIN MX_GPIO_Init_1 */
/* USER CODE END MX_GPIO_Init_1 */

  /* GPIO Ports Clock Enable */
  __HAL_RCC_GPIOE_CLK_ENABLE();
  __HAL_RCC_GPIOC_CLK_ENABLE();
  __HAL_RCC_GPIOH_CLK_ENABLE();
  __HAL_RCC_GPIOA_CLK_ENABLE();
  __HAL_RCC_GPIOB_CLK_ENABLE();
  __HAL_RCC_GPIOD_CLK_ENABLE();

  /*Configure GPIO pin Output Level */
  HAL_GPIO_WritePin(CS_I2C_SPI_GPIO_Port, CS_I2C_SPI_Pin, GPIO_PIN_RESET);

  /*Configure GPIO pin Output Level */
  HAL_GPIO_WritePin(OTG_FS_PowerSwitchOn_GPIO_Port, OTG_FS_PowerSwitchOn_Pin, GPIO_PIN_SET);

  /*Configure GPIO pin Output Level */
  HAL_GPIO_WritePin(GPIOD, LD4_Pin|LD3_Pin|LD5_Pin|LD6_Pin
                          |Audio_RST_Pin, GPIO_PIN_RESET);

  /*Configure GPIO pin : CS_I2C_SPI_Pin */
  GPIO_InitStruct.Pin = CS_I2C_SPI_Pin;
  GPIO_InitStruct.Mode = GPIO_MODE_OUTPUT_PP;
  GPIO_InitStruct.Pull = GPIO_NOPULL;
  GPIO_InitStruct.Speed = GPIO_SPEED_FREQ_LOW;
  HAL_GPIO_Init(CS_I2C_SPI_GPIO_Port, &GPIO_InitStruct);

  /*Configure GPIO pin : OTG_FS_PowerSwitchOn_Pin */
  GPIO_InitStruct.Pin = OTG_FS_PowerSwitchOn_Pin;
  GPIO_InitStruct.Mode = GPIO_MODE_OUTPUT_PP;
  GPIO_InitStruct.Pull = GPIO_NOPULL;
  GPIO_InitStruct.Speed = GPIO_SPEED_FREQ_LOW;
  HAL_GPIO_Init(OTG_FS_PowerSwitchOn_GPIO_Port, &GPIO_InitStruct);

  /*Configure GPIO pin : PDM_OUT_Pin */
  GPIO_InitStruct.Pin = PDM_OUT_Pin;
  GPIO_InitStruct.Mode = GPIO_MODE_AF_PP;
  GPIO_InitStruct.Pull = GPIO_NOPULL;
  GPIO_InitStruct.Speed = GPIO_SPEED_FREQ_LOW;
  GPIO_InitStruct.Alternate = GPIO_AF5_SPI2;
  HAL_GPIO_Init(PDM_OUT_GPIO_Port, &GPIO_InitStruct);

  /*Configure GPIO pin : B1_Pin */
  GPIO_InitStruct.Pin = B1_Pin;
  GPIO_InitStruct.Mode = GPIO_MODE_IT_RISING;
  GPIO_InitStruct.Pull = GPIO_NOPULL;
  HAL_GPIO_Init(B1_GPIO_Port, &GPIO_InitStruct);

  /*Configure GPIO pin : I2S3_WS_Pin */
  GPIO_InitStruct.Pin = I2S3_WS_Pin;
  GPIO_InitStruct.Mode = GPIO_MODE_AF_PP;
  GPIO_InitStruct.Pull = GPIO_NOPULL;
  GPIO_InitStruct.Speed = GPIO_SPEED_FREQ_LOW;
  GPIO_InitStruct.Alternate = GPIO_AF6_SPI3;
  HAL_GPIO_Init(I2S3_WS_GPIO_Port, &GPIO_InitStruct);

  /*Configure GPIO pins : SPI1_SCK_Pin SPI1_MISO_Pin SPI1_MOSI_Pin */
  GPIO_InitStruct.Pin = SPI1_SCK_Pin|SPI1_MISO_Pin|SPI1_MOSI_Pin;
  GPIO_InitStruct.Mode = GPIO_MODE_AF_PP;
  GPIO_InitStruct.Pull = GPIO_NOPULL;
  GPIO_InitStruct.Speed = GPIO_SPEED_FREQ_LOW;
  GPIO_InitStruct.Alternate = GPIO_AF5_SPI1;
  HAL_GPIO_Init(GPIOA, &GPIO_InitStruct);

  /*Configure GPIO pin : BOOT1_Pin */
  GPIO_InitStruct.Pin = BOOT1_Pin;
  GPIO_InitStruct.Mode = GPIO_MODE_INPUT;
  GPIO_InitStruct.Pull = GPIO_NOPULL;
  HAL_GPIO_Init(BOOT1_GPIO_Port, &GPIO_InitStruct);

  /*Configure GPIO pin : CLK_IN_Pin */
  GPIO_InitStruct.Pin = CLK_IN_Pin;
  GPIO_InitStruct.Mode = GPIO_MODE_AF_PP;
  GPIO_InitStruct.Pull = GPIO_NOPULL;
  GPIO_InitStruct.Speed = GPIO_SPEED_FREQ_LOW;
  GPIO_InitStruct.Alternate = GPIO_AF5_SPI2;
  HAL_GPIO_Init(CLK_IN_GPIO_Port, &GPIO_InitStruct);

  /*Configure GPIO pins : LD4_Pin LD3_Pin LD5_Pin LD6_Pin
                           Audio_RST_Pin */
  GPIO_InitStruct.Pin = LD4_Pin|LD3_Pin|LD5_Pin|LD6_Pin
                          |Audio_RST_Pin;
  GPIO_InitStruct.Mode = GPIO_MODE_OUTPUT_PP;
  GPIO_InitStruct.Pull = GPIO_NOPULL;
  GPIO_InitStruct.Speed = GPIO_SPEED_FREQ_LOW;
  HAL_GPIO_Init(GPIOD, &GPIO_InitStruct);

  /*Configure GPIO pins : I2S3_MCK_Pin I2S3_SCK_Pin I2S3_SD_Pin */
  GPIO_InitStruct.Pin = I2S3_MCK_Pin|I2S3_SCK_Pin|I2S3_SD_Pin;
  GPIO_InitStruct.Mode = GPIO_MODE_AF_PP;
  GPIO_InitStruct.Pull = GPIO_NOPULL;
  GPIO_InitStruct.Speed = GPIO_SPEED_FREQ_LOW;
  GPIO_InitStruct.Alternate = GPIO_AF6_SPI3;
  HAL_GPIO_Init(GPIOC, &GPIO_InitStruct);

  /*Configure GPIO pin : VBUS_FS_Pin */
  GPIO_InitStruct.Pin = VBUS_FS_Pin;
  GPIO_InitStruct.Mode = GPIO_MODE_INPUT;
  GPIO_InitStruct.Pull = GPIO_NOPULL;
  HAL_GPIO_Init(VBUS_FS_GPIO_Port, &GPIO_InitStruct);

  /*Configure GPIO pins : OTG_FS_ID_Pin OTG_FS_DM_Pin OTG_FS_DP_Pin */
  GPIO_InitStruct.Pin = OTG_FS_ID_Pin|OTG_FS_DM_Pin|OTG_FS_DP_Pin;
  GPIO_InitStruct.Mode = GPIO_MODE_AF_PP;
  GPIO_InitStruct.Pull = GPIO_NOPULL;
  GPIO_InitStruct.Speed = GPIO_SPEED_FREQ_LOW;
  GPIO_InitStruct.Alternate = GPIO_AF10_OTG_FS;
  HAL_GPIO_Init(GPIOA, &GPIO_InitStruct);

  /*Configure GPIO pin : OTG_FS_OverCurrent_Pin */
  GPIO_InitStruct.Pin = OTG_FS_OverCurrent_Pin;
  GPIO_InitStruct.Mode = GPIO_MODE_INPUT;
  GPIO_InitStruct.Pull = GPIO_NOPULL;
  HAL_GPIO_Init(OTG_FS_OverCurrent_GPIO_Port, &GPIO_InitStruct);

  /*Configure GPIO pins : Audio_SCL_Pin Audio_SDA_Pin */
  GPIO_InitStruct.Pin = Audio_SCL_Pin|Audio_SDA_Pin;
  GPIO_InitStruct.Mode = GPIO_MODE_AF_OD;
  GPIO_InitStruct.Pull = GPIO_NOPULL;
  GPIO_InitStruct.Speed = GPIO_SPEED_FREQ_LOW;
  GPIO_InitStruct.Alternate = GPIO_AF4_I2C1;
  HAL_GPIO_Init(GPIOB, &GPIO_InitStruct);

  /*Configure GPIO pin : MEMS_INT2_Pin */
  GPIO_InitStruct.Pin = MEMS_INT2_Pin;
  GPIO_InitStruct.Mode = GPIO_MODE_EVT_RISING;
  GPIO_InitStruct.Pull = GPIO_NOPULL;
  HAL_GPIO_Init(MEMS_INT2_GPIO_Port, &GPIO_InitStruct);

/* USER CODE BEGIN MX_GPIO_Init_2 */
/* USER CODE END MX_GPIO_Init_2 */
}

/* USER CODE BEGIN 4 */
void bit_rev(complex *X, uint16_t size)
{
    uint16_t i,j,k;

    complex temp;	/* temporary storage of the complex variable */

    j = 0;
    for (i=1;i<size-1;i++)
    {

    	k = size>>1; // size/2
        while(k<=j)
        {
           	j-=k;
            k>>=1; // k = k/2
        }
        j+=k;

        if (i<j) // swap
        {
          temp = X[j];
          X[j] = X[i];
          X[i] = temp;
        }
    }
}

void bit_rev_fixed_point(complex_fixed_point *X, uint16_t size)
{
    uint16_t i,j,k;

    complex_fixed_point temp;	/* temporary storage of the complex variable */

    j = 0;
    for (i=1;i<size-1;i++)
    {

    	k = size>>1; // size/2
        while(k<=j)
        {
           	j-=k;
            k>>=1; // k = k/2
        }
        j+=k;

        if (i<j) // swap
        {
          temp = X[j];
          X[j] = X[i];
          X[i] = temp;
        }
    }
}

void fft(complex *X, uint16_t num_stages, complex *W, uint8_t scale_or_not)
{
    complex temp, P, Q, temp1;           /* temporary storage of complex variable */
    complex U;              /* twiddle factor W^k */
    uint16_t j;
    uint16_t butterfly_top_index, butterfly_bottom_index;        /* index for higher and lower points in butterfly */
    uint16_t num_pt_FFT = 1 << num_stages;  /* number of points for FFT */
    uint16_t  L;         /* FFT stage */
    /* number of points in sub DFT at stage L and offset to next DFT in stage */
    uint16_t  num_pt_sub_DFT;
    /* number of butterflies in one DFT at stage L.  Also is offset to lower point in butterfly at stage L */
    uint16_t  num_butterflies;

    float scale;
    if (scale_or_not == 0) {
    	scale = 1.0;
    } else {
    	scale = 0.5;
    }

    for (L=1; L<=FILL_IN_BLANK; L++) 	/* iteration over stages */
    {
    	num_pt_sub_DFT=1<<L;        	/* 2^L=points of sub DFT, variable D in lecture */
    	num_butterflies=num_pt_sub_DFT>>1;      	/* number of butterflies in sub-DFT, variable B in lecture */

    	// reset twiddle factor
    	U.re = 1.0;
        U.im = 0.;

        for (j=0; j<FILL_IN_BLANK;j++) //iteration over butterflies
        {

            for(butterfly_top_index=j; butterfly_top_index<num_pt_FFT; butterfly_top_index+=FILL_IN_BLANK) /* Do the butterflies */
            {
            	// butterfly_top_index is variable i in lecture
            	// butterfly_bottom_index is variable k in lecture
            	butterfly_bottom_index=butterfly_top_index+FILL_IN_BLANK;

                // Compute butterfly - in place computation
            	// FILL_IN_BLANK: temp = U * X[butterfly_bottom_index], compute temp.re and temp.im


               	// FILL_IN_BLANK: X[i] in lecture = P = X[butterfly_top_index] + temp, compute P.re and P.im, also SCALE


               	// FILL_IN_BLANK: X[k] in lecture = Q = X[butterfly_top_index] - temp, compute Q.re and PQ.im, also SCALE


               	// FILL_IN_BLANK: X[i] in lecture = X[butterfly_top_index] = P, X[k] in lecture = X[butterfly_bottom_index] = Q, assign re and im parts

            }

            // update twiddle factor: U = U*W[L-1]
            // FILL_IN_BLANK: compute temp1.re

            U.im = U.re*W[L-1].im + U.im*W[L-1].re;
            U.re = temp1.re;
        }
    }
}

void fft_fixed_point(complex_fixed_point *X, uint16_t num_stages, complex_fixed_point *W, uint8_t scale_or_not)
{
    complex_fixed_point temp, P, Q, temp1;           /* temporary storage of complex variable */
    complex_fixed_point U;              /* twiddle factor W^k */
    uint16_t j;
    uint16_t butterfly_top_index, butterfly_bottom_index;        /* index for higher and lower points in butterfly */
    uint16_t num_pt_FFT = 1 << num_stages;  /* number of points for FFT */
    uint16_t  L;         /* FFT stage */
    /* number of points in sub DFT at stage L and offset to next DFT in stage */
    uint16_t  num_pt_sub_DFT;
    /* number of butterflies in one DFT at stage L.  Also is offset to lower point in butterfly at stage L */
    uint16_t  num_butterflies;

    uint8_t scale;
    if (scale_or_not == 0) {
    	scale = 0;
    } else {
    	scale = 1;
    }

    for (L=1; L<=FILL_IN_BLANK; L++) 	/* iteration over stages */
    {
    	num_pt_sub_DFT=1<<L;        	/* 2^L=points of sub DFT, variable D in lecture */
    	num_butterflies=num_pt_sub_DFT>>1;      	/* number of butterflies in sub-DFT, variable B in lecture */

    	// reset twiddle factor
    	U.re = 1 << shift_factor;
        U.im = 0;

        for (j=0; j<FILL_IN_BLANK;j++) //iteration over butterflies
        {

            for(butterfly_top_index=j; butterfly_top_index<num_pt_FFT; butterfly_top_index+=FILL_IN_BLANK) /* Do the butterflies */
            {
            	// butterfly_top_index is variable i in lecture
            	// butterfly_bottom_index is variable k in lecture
            	butterfly_bottom_index=butterfly_top_index+FILL_IN_BLANK;

                // Compute butterfly - in place computation
            	// FILL_IN_BLANK: temp = U * X[butterfly_bottom_index], compute temp.re and temp.im


               	// FILL_IN_BLANK: X[i] in lecture = P = X[butterfly_top_index] + temp, compute P.re and P.im, also SCALE


               	// FILL_IN_BLANK: X[k] in lecture = Q = X[butterfly_top_index] - temp, compute Q.re and PQ.im, also SCALE


               	// FILL_IN_BLANK: X[i] in lecture = X[butterfly_top_index] = P, X[k] in lecture = X[butterfly_bottom_index] = Q, assign re and im parts

            }


            // update twiddle factor: U = U*W[L-1]
            // FILL_IN_BLANK: compute temp1.re

            U.im = (U.re*W[L-1].im + U.im*W[L-1].re)>>shift_factor;
            U.re = temp1.re;
        }
    }
}
/* USER CODE END 4 */

/**
  * @brief  This function is executed in case of error occurrence.
  * @retval None
  */
void Error_Handler(void)
{
  /* USER CODE BEGIN Error_Handler_Debug */
  /* User can add his own implementation to report the HAL error return state */
  __disable_irq();
  while (1)
  {
  }
  /* USER CODE END Error_Handler_Debug */
}

#ifdef  USE_FULL_ASSERT
/**
  * @brief  Reports the name of the source file and the source line number
  *         where the assert_param error has occurred.
  * @param  file: pointer to the source file name
  * @param  line: assert_param error line source number
  * @retval None
  */
void assert_failed(uint8_t *file, uint32_t line)
{
  /* USER CODE BEGIN 6 */
  /* User can add his own implementation to report the file name and line number,
     ex: printf("Wrong parameters value: file %s on line %d\r\n", file, line) */
  /* USER CODE END 6 */
}
#endif /* USE_FULL_ASSERT */
